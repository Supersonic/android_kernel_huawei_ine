## drivers/devkit/tpkit/3_0/panel/Kconfig
```kconfig
#
# huawei touchscreen driver configuration
#


source "drivers/devkit/tpkit/3_0/panel/synaptics/Kconfig"
source "drivers/devkit/tpkit/3_0/panel/samsung/Kconfig"
```

## kernel/sched/Kconfig
```kconfig
config SCHED_HISI_WALT_WINDOW_SIZE_TUNABLE
	bool "Make WALT window size tunable"
	depends on SCHED_WALT
	default n
	help
	  Make walt_ravg_window tunable in early param.

config SCHED_HISI_DOWNMIGRATE_LOWER_LOAD
	bool "Schedutil governor use lower load when task downmigrate"
	depends on SCHED_WALT
	depends on CPU_FREQ_GOV_SCHEDUTIL
	default n
	help
	  Schedutil governor migrate cpu busy time when task migrate. This
	  option will recaculate a lower load for task downmigrate to
	  prevent little core's frequency increase too much.

config SCHED_HISI_CALC_CUM_WINDOW_DEMAND
	bool "WALT calculate cum window demand"
	depends on SCHED_HISI_WALT_FOR_SCHED
	default n
	help
	  This option caculates WALT's cum_window_demand, which is not used
	  currently.

config SCHED_HISI_CHECK_IRQLOAD
	bool "Scheduler check irqload when select task's cpu"
	depends on SCHED_WALT
	default n
	help
	  WALT caculates an irqload for each cpu and scheduler will avoid
	  placing task on a high irqload cpu (if WALT enabled).
	  Default disabled because we haven't tested to find out which
	  threshold is the best.

config SCHED_HISI_TOP_TASK
	bool "Maintain the top task load of each cpu"
	depends on SCHED_WALT
	default n
	help
	  Hisi schedutil governor may use the top task load as a guide to
	  frequency evaluation.

config SCHED_HISI_WALT_FOR_SCHED
	bool "Schedule related WALT signals"
	depends on SCHED_WALT
	default n
	help
	  This option enables calculation of WALT's task demand and rq
	  cumulative runnable avg.

	  Say N if WALT signal is not used in scheduler. There might be a
	  little cost for WALT task demand update.
	  If selected, control sysctl_sched_use_walt_cpu_util and
	  sysctl_sched_use_walt_task_util to use it in cpu_util and
	  task_util.
```
